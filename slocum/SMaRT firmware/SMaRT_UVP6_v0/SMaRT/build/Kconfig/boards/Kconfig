## slocum/SMaRT firmware/SMaRT_UVP6_v0/SMaRT/build/Kconfig/boards/Kconfig
```kconfig
# Load Zephyr board Kconfig descriptions.
osource "/home/glider/zephyrproject/zephyr/boards/raspberrypi/rpi_pico/Kconfig"
```

## slocum/SMaRT firmware/SMaRT_UVP6_v0/SMaRT/build/Kconfig/boards/Kconfig.defconfig
```kconfig
# Load Zephyr board defconfig descriptions.
osource "/home/glider/zephyrproject/zephyr/boards/raspberrypi/rpi_pico/Kconfig.defconfig"
```

## slocum/SMaRT firmware/SMaRT_eDNA_v0/SMaRT/build/Kconfig/boards/Kconfig.rpi_pico
```kconfig
# Load board Kconfig descriptions.
osource "/home/glider/zephyrproject/zephyr/boards/raspberrypi/rpi_pico/Kconfig.rpi_pico"
```

## slocum/SMaRT_firmware/SMaRT_UVP6_v1/build/Kconfig/arch/Kconfig
```kconfig
# Load Zephyr Arch Kconfig descriptions.
osource "/home/glider/zephyrproject/zephyr/arch/rx/Kconfig"
osource "/home/glider/zephyrproject/zephyr/arch/x86/Kconfig"
osource "/home/glider/zephyrproject/zephyr/arch/xtensa/Kconfig"
osource "/home/glider/zephyrproject/zephyr/arch/sparc/Kconfig"
osource "/home/glider/zephyrproject/zephyr/arch/riscv/Kconfig"
osource "/home/glider/zephyrproject/zephyr/arch/posix/Kconfig"
osource "/home/glider/zephyrproject/zephyr/arch/mips/Kconfig"
osource "/home/glider/zephyrproject/zephyr/arch/arm64/Kconfig"
osource "/home/glider/zephyrproject/zephyr/arch/arm/Kconfig"
osource "/home/glider/zephyrproject/zephyr/arch/arc/Kconfig"
```

## slocum/SMaRT_firmware/SMaRT_eDNA_v0/build/Kconfig/boards/Kconfig.sysbuild
```kconfig
# Load Sysbuild board Kconfig descriptions.
osource "/home/glider/zephyrproject/zephyr/boards/raspberrypi/rpi_pico/Kconfig.sysbuild"
```
